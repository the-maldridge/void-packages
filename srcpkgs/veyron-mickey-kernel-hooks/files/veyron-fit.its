## srcpkgs/veyron-mickey-kernel-hooks/files/veyron-fit.its
```
/dts-v1/;

/ {
    description = "Void Linux FIT Image for ASUS Chromebit (veyron_mickey)";
    #address-cells = <1>;

    images {
        kernel-1 {
            description = "Void ARMv7 zImage Kernel";
            data = /incbin/("@KERNEL_PATH@");
            type = "kernel_noload";
            arch = "arm";
            os = "linux";
            compression = "none";   /* Keep none because zImage self-decompresses */
            load = <0>;
            entry = <0>;
            hash-1 {
                algo = "sha1";
            };
        };
        fdt-1 {
            description = "rk3288-veyron-mickey.dtb";
            data = /incbin/("@DTB_PATH@");
            type = "flat_dt";
            arch = "arm";
            compression = "none";
            hash-1 {
                algo = "sha1";
            };
        };
    };

    configurations {
        default = "config-1";
        config-1 {
            description = "Boot Void Linux";
            kernel = "kernel-1";
            fdt = "fdt-1";
        };
    };
};
```
